#include <Wire.h>
#include <Adafruit_GFX.h>
#include <Adafruit_SSD1306.h>
#include <Adafruit_NeoPixel.h>

#define SCREEN_WIDTH 128
#define SCREEN_HEIGHT 64

#define OLED_RESET -1
Adafruit_SSD1306 display(SCREEN_WIDTH, SCREEN_HEIGHT, &Wire, OLED_RESET);

#define BUTTON_MINUS_1 32
#define BUTTON_PLUS_1 33
#define BUTTON_PLUS_3 25
#define BUTTON_PLUS_5 26
#define BUTTON_NEXT 27

#define LED_PIN 14
#define LED_COUNT 24
Adafruit_NeoPixel strip(LED_COUNT, LED_PIN, NEO_GRB + NEO_KHZ800);

int numberOfPlayers = 1;
int currentPlayer = 1;
int playerScores[8] = {0};
bool gameOver = false;

enum GameMode { GAME_40_POINTS, GAME_22_POINTS };
int selectedGame = GAME_40_POINTS;
bool gameSelected = false;

// Bitmap images for the number of players
const unsigned char player_1_bitmap[] PROGMEM = {
	0x00, 0x00, 0x00, 0x00, 0x00, 0x00, 0x00, 0x00, 0x00, 0x00, 0x00, 0x00, 0x00, 0x00, 0x00, 0x00, 
	0x00, 0x00, 0x00, 0x00, 0x00, 0x00, 0x00, 0x00, 0x00, 0x00, 0x00, 0x00, 0x00, 0x00, 0x00, 0x00, 
	0x00, 0x00, 0x00, 0x00, 0x00, 0x00, 0x00, 0x00, 0x00, 0x00, 0x00, 0x00, 0x00, 0x00, 0x00, 0x00, 
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	0x00, 0x00, 0x00, 0x00, 0x00, 0x00, 0x00, 0x00, 0x00, 0x00, 0x00, 0x00, 0x00, 0x00, 0x00, 0x00
};

const unsigned char player_2_bitmap[] PROGMEM = {
	0x00, 0x00, 0x00, 0x00, 0x00, 0x00, 0x00, 0x00, 0x00, 0x00, 0x00, 0x00, 0x00, 0x00, 0x00, 0x00, 
	0x00, 0x00, 0x00, 0x00, 0x00, 0x00, 0x00, 0x00, 0x00, 0x00, 0x00, 0x00, 0x00, 0x00, 0x00, 0x00, 
	0x00, 0x00, 0x00, 0x00, 0x00, 0x00, 0x00, 0x00, 0x00, 0x00, 0x00, 0x00, 0x00, 0x00, 0x00, 0x00, 
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	0x00, 0x00, 0x00, 0x00, 0x00, 0x00, 0x00, 0x00, 0x00, 0x00, 0x00, 0x00, 0x00, 0x00, 0x00, 0x00
};


const unsigned char player_3_bitmap[] PROGMEM = {
	0x00, 0x00, 0x00, 0x00, 0x00, 0x00, 0x00, 0x00, 0x00, 0x00, 0x00, 0x00, 0x00, 0x00, 0x00, 0x00, 
	0x00, 0x00, 0x00, 0x00, 0x00, 0x00, 0x00, 0x00, 0x00, 0x00, 0x00, 0x00, 0x00, 0x00, 0x00, 0x00, 
	0x00, 0x00, 0x00, 0x00, 0x00, 0x00, 0x00, 0x00, 0x00, 0x00, 0x00, 0x00, 0x00, 0x00, 0x00, 0x00, 
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	0x00, 0x00, 0x00, 0x00, 0x00, 0x00, 0x00, 0x00, 0x00, 0x00, 0x00, 0x00, 0x00, 0x00, 0x00, 0x00
};


const unsigned char player_4_bitmap[] PROGMEM = {
	0x00, 0x00, 0x00, 0x00, 0x00, 0x00, 0x00, 0x00, 0x00, 0x00, 0x00, 0x00, 0x00, 0x00, 0x00, 0x00, 
	0x00, 0x00, 0x00, 0x00, 0x00, 0x00, 0x00, 0x00, 0x00, 0x00, 0x00, 0x00, 0x00, 0x00, 0x00, 0x00, 
	0x00, 0x00, 0x00, 0x00, 0x00, 0x00, 0x00, 0x00, 0x00, 0x00, 0x00, 0x00, 0x00, 0x00, 0x00, 0x00, 
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	0x00, 0x00, 0x00, 0x00, 0x00, 0x00, 0x00, 0x00, 0x00, 0x00, 0x00, 0x00, 0x00, 0x00, 0x00, 0x00
};


const unsigned char player_5_bitmap[] PROGMEM = {
	0x00, 0x00, 0x00, 0x00, 0x00, 0x00, 0x00, 0x00, 0x00, 0x00, 0x00, 0x00, 0x00, 0x00, 0x00, 0x00, 
	0x00, 0x00, 0x00, 0x00, 0x00, 0x00, 0x00, 0x00, 0x00, 0x00, 0x00, 0x00, 0x00, 0x00, 0x00, 0x00, 
	0x00, 0x00, 0x00, 0x00, 0x00, 0x00, 0x00, 0x00, 0x00, 0x00, 0x00, 0x00, 0x00, 0x00, 0x00, 0x00, 
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	0x00, 0x00, 0x00, 0x00, 0x00, 0x00, 0x00, 0x00, 0x00, 0x00, 0x00, 0x00, 0x00, 0x00, 0x00, 0x00
};

const unsigned char player_6_bitmap[] PROGMEM = {
	0x00, 0x00, 0x00, 0x00, 0x00, 0x00, 0x00, 0x00, 0x00, 0x00, 0x00, 0x00, 0x00, 0x00, 0x00, 0x00, 
	0x00, 0x00, 0x00, 0x00, 0x00, 0x00, 0x00, 0x00, 0x00, 0x00, 0x00, 0x00, 0x00, 0x00, 0x00, 0x00, 
	0x00, 0x00, 0x00, 0x00, 0x00, 0x00, 0x00, 0x00, 0x00, 0x00, 0x00, 0x00, 0x00, 0x00, 0x00, 0x00, 
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	0x00, 0x00, 0x00, 0x00, 0x00, 0x00, 0x00, 0x00, 0x00, 0x00, 0x00, 0x00, 0x00, 0x00, 0x00, 0x00
};

const unsigned char player_7_bitmap[] PROGMEM = {
	0x00, 0x00, 0x00, 0x00, 0x00, 0x00, 0x00, 0x00, 0x00, 0x00, 0x00, 0x00, 0x00, 0x00, 0x00, 0x00, 
	0x00, 0x00, 0x00, 0x00, 0x00, 0x00, 0x00, 0x00, 0x00, 0x00, 0x00, 0x00, 0x00, 0x00, 0x00, 0x00, 
	0x00, 0x00, 0x00, 0x00, 0x00, 0x00, 0x00, 0x00, 0x00, 0x00, 0x00, 0x00, 0x00, 0x00, 0x00, 0x00, 
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	0x00, 0x00, 0x00, 0x00, 0x00, 0x00, 0x00, 0x00, 0x00, 0x00, 0x00, 0x00, 0x00, 0x00, 0x00, 0x00
};

const unsigned char player_8_bitmap[] PROGMEM = {
	0x00, 0x00, 0x00, 0x00, 0x00, 0x00, 0x00, 0x00, 0x00, 0x00, 0x00, 0x00, 0x00, 0x00, 0x00, 0x00, 
	0x00, 0x00, 0x00, 0x00, 0x00, 0x00, 0x00, 0x00, 0x00, 0x00, 0x00, 0x00, 0x00, 0x00, 0x00, 0x00, 
	0x00, 0x00, 0x00, 0x00, 0x00, 0x00, 0x00, 0x00, 0x00, 0x00, 0x00, 0x00, 0x00, 0x00, 0x00, 0x00, 
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	0x00, 0x00, 0x00, 0x00, 0x00, 0x00, 0x00, 0x00, 0x00, 0x00, 0x00, 0x00, 0x00, 0x00, 0x00, 0x00
};
// Add similar bitmap definitions for player_3_bitmap, player_4_bitmap, etc.

// Bitmap image data for '22 point' game
const unsigned char epd_bitmap_gameMode22[] PROGMEM = {
    0x00, 0x00, 0x00, 0x00, 0x00, 0x00, 0x00, 0x00, 0x00, 0x00, 0x00, 0x00, 0x00, 0x00, 0x00, 0x00, 
    0x00, 0x00, 0x00, 0x00, 0x00, 0x00, 0x00, 0x00, 0x00, 0x00, 0x00, 0x00, 0x00, 0x00, 0x00, 0x00, 
    0x00, 0x00, 0x1e, 0x3f, 0xb8, 0x3f, 0x8f, 0x9f, 0xf0, 0x3e, 0x06, 0x0e, 0x1e, 0xff, 0x00, 0x00, 
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    0x00, 0x00, 0x00, 0x00, 0x00, 0x00, 0x00, 0x00, 0x00, 0x00, 0x00, 0x00, 0x00, 0x00, 0x00, 0x00
};

// Bitmap image data for '40 point' game
const unsigned char epd_bitmap_gameMode40[] PROGMEM = {
    0x00, 0x00, 0x00, 0x00, 0x00, 0x00, 0x00, 0x00, 0x00, 0x00, 0x00, 0x00, 0x00, 0x00, 0x00, 0x00, 
    0x00, 0x00, 0x00, 0x00, 0x00, 0x00, 0x00, 0x00, 0x00, 0x00, 0x00, 0x00, 0x00, 0x00, 0x00, 0x00, 
    0x00, 0x00, 0x1e, 0x3f, 0xb8, 0x3f, 0x8f, 0x9f, 0xf0, 0x3e, 0x06, 0x0e, 0x1e, 0xff, 0x00, 0x00, 
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    0x00, 0x00, 0x00, 0x00, 0x00, 0x00, 0x00, 0x00, 0x00, 0x00, 0x00, 0x00, 0x00, 0x00, 0x00, 0x00
};

void updateGameSelectionScreen();
void updatePlayerSelectionScreen();
void updateDisplay();
void updateLEDsBasedOnScore(int score);
void startGame();
void playGameRound(int winningScore);
void displayWinner(int winningPlayer);
bool checkButtonPress(int buttonPin);

void setup() {
  Serial.begin(9600);

  pinMode(BUTTON_MINUS_1, INPUT_PULLUP);
  pinMode(BUTTON_PLUS_1, INPUT_PULLUP);
  pinMode(BUTTON_PLUS_3, INPUT_PULLUP);
  pinMode(BUTTON_PLUS_5, INPUT_PULLUP);
  pinMode(BUTTON_NEXT, INPUT_PULLUP);

  if (!display.begin(SSD1306_SWITCHCAPVCC, 0x3C)) {
    Serial.println(F("SSD1306 allocation failed"));
    for (;;);
  }
  display.display();
  display.clearDisplay();

  updateGameSelectionScreen();
}

void loop() {
  if (!gameSelected) {
    if (checkButtonPress(BUTTON_MINUS_1)) {
      selectedGame = (selectedGame == GAME_40_POINTS) ? GAME_22_POINTS : GAME_40_POINTS;
      updateGameSelectionScreen();
    }
    if (checkButtonPress(BUTTON_PLUS_1)) {
      selectedGame = (selectedGame == GAME_40_POINTS) ? GAME_22_POINTS : GAME_40_POINTS;
      updateGameSelectionScreen();
    }
    if (checkButtonPress(BUTTON_NEXT)) {
      gameSelected = true;
      updatePlayerSelectionScreen();
    }
  } else {
    if (checkButtonPress(BUTTON_MINUS_1)) {
      numberOfPlayers = max(1, numberOfPlayers - 1);
      updatePlayerSelectionScreen();
    }
    if (checkButtonPress(BUTTON_PLUS_1)) {
      numberOfPlayers = min(8, numberOfPlayers + 1);
      updatePlayerSelectionScreen();
    }
    if (checkButtonPress(BUTTON_NEXT)) {
      startGame();
    }
  }
}

bool checkButtonPress(int buttonPin) {
  if (digitalRead(buttonPin) == LOW) {
    delay(200);
    return true;
  }
  return false;
}

void startGame() {
  if (selectedGame == GAME_40_POINTS) {
    playGameRound(40);
  } else if (selectedGame == GAME_22_POINTS) {
    playGameRound(22);
  }
}

void playGameRound(int winningScore) {
  bool extraTurnRequired = false;
  bool shootout = false;
  int turnCounter[8] = {0};
  int shootoutPlayers[8] = {0};

  while (!gameOver) {
    extraTurnRequired = false;
    for (int i = 0; i < numberOfPlayers; i++) {
      currentPlayer = i + 1;
      if (playerScores[currentPlayer - 1] == -100) continue; // Skip eliminated players
      int playerScore = playerScores[currentPlayer - 1];
      turnCounter[currentPlayer - 1]++;

      while (true) {
        display.clearDisplay();
        display.setTextSize(2);
        display.setTextColor(SSD1306_WHITE);
        display.setCursor(0, 10);
        display.print("PLAYER ");
        display.print(currentPlayer);
        display.setCursor(0, 30);
        display.print("Score: ");
        display.print(playerScore);
        display.display();

        updateLEDsBasedOnScore(playerScore);

        if (checkButtonPress(BUTTON_MINUS_1)) playerScore--;
        if (checkButtonPress(BUTTON_PLUS_1)) playerScore++;
        if (checkButtonPress(BUTTON_PLUS_3)) playerScore += 3;
        if (checkButtonPress(BUTTON_PLUS_5)) playerScore += 5;

        if (checkButtonPress(BUTTON_NEXT)) {
          if (playerScore < -10) {
            playerScores[currentPlayer - 1] = -100; // Mark player as eliminated
          } else if (playerScore > 40) {
            playerScores[currentPlayer - 1] = 22; // Reset score to 22 if over 40
          } else {
            playerScores[currentPlayer - 1] = playerScore; // Update player's score
          }
          break;
        }
      }

      if (playerScores[currentPlayer - 1] == winningScore) {
        extraTurnRequired = true;
      }
    }

    if (extraTurnRequired) {
      for (int i = 0; i < numberOfPlayers; i++) {
        if (turnCounter[i] == turnCounter[currentPlayer - 1] - 1) {
          currentPlayer = i + 1;
          int playerScore = playerScores[currentPlayer - 1];

          while (true) {
            display.clearDisplay();
            display.setTextSize(2);
            display.setTextColor(SSD1306_WHITE);
            display.setCursor(0, 10);
            display.print("PLAYER ");
            display.print(currentPlayer);
            display.setCursor(0, 30);
            display.print("Score: ");
            display.print(playerScore);
            display.display();

            updateLEDsBasedOnScore(playerScore);

            if (checkButtonPress(BUTTON_MINUS_1)) playerScore--;
            if (checkButtonPress(BUTTON_PLUS_1)) playerScore++;
            if (checkButtonPress(BUTTON_PLUS_3)) playerScore += 3;
            if (checkButtonPress(BUTTON_PLUS_5)) playerScore += 5;

            if (checkButtonPress(BUTTON_NEXT)) {
              if (playerScore < -10) {
                playerScores[currentPlayer - 1] = -100; // Mark player as eliminated
              } else if (playerScore > 40) {
                playerScores[currentPlayer - 1] = 22; // Reset score to 22 if over 40
              } else {
                playerScores[currentPlayer - 1] = playerScore; // Update player's score
              }
              break;
            }
          }
        }
      }
    }

    int winners = 0, winningPlayer = -1; // Initialize winningPlayer to -1 to avoid "Player 0 wins"
    for (int i = 0; i < numberOfPlayers; i++) {
      if (playerScores[i] == winningScore) {
        winners++;
        winningPlayer = i; // Keep the index as is, will add 1 while displaying
      }
    }

    if (winners > 1) {
      shootout = true;
      for (int i = 0; i < numberOfPlayers; i++) {
        if (playerScores[i] == winningScore) shootoutPlayers[i] = 1;
      }

      while (shootout) {
        display.clearDisplay();
        display.setTextSize(1);
        display.setTextColor(SSD1306_WHITE);
        display.setCursor(0, 10);
        display.println("SHOOTOUT!");
        display.display();
        delay(2000);

        int maxScore = -1, shootoutWinningPlayer = -1;
        bool tie = false;
        for (int i = 0; i < numberOfPlayers; i++) {
          if (shootoutPlayers[i] == 1) {
            currentPlayer = i + 1;
            int playerScore = 0;

            while (true) {
              display.clearDisplay();
              display.setTextSize(2);
              display.setTextColor(SSD1306_WHITE);
              display.setCursor(0, 10);
              display.print("PLAYER ");
              display.print(currentPlayer);
              display.setCursor(0, 30);
              display.print("Score: ");
              display.print(playerScore);
              display.display();

              if (checkButtonPress(BUTTON_MINUS_1)) playerScore--;
              if (checkButtonPress(BUTTON_PLUS_1)) playerScore++;
              if (checkButtonPress(BUTTON_PLUS_3)) playerScore += 3;
              if (checkButtonPress(BUTTON_PLUS_5)) playerScore += 5;

              if (checkButtonPress(BUTTON_NEXT)) {
                if (playerScore < -10) {
                  shootoutPlayers[i] = 0; // Eliminate player from shootout
                } else {
                  playerScores[currentPlayer - 1] = playerScore; // Update player's score
                }
                break;
              }
            }

            if (playerScore > maxScore) {
              maxScore = playerScore;
              shootoutWinningPlayer = currentPlayer;
              tie = false;
            } else if (playerScore == maxScore) {
              tie = true;
            }
          }
        }

        if (!tie) {
          gameOver = true;
          displayWinner(shootoutWinningPlayer);
          return;
        }
      }
    } else if (winners == 1) {
      gameOver = true;
      displayWinner(winningPlayer + 1); // Add 1 to adjust for 0-indexing
      return;
    }
  }
}

void displayWinner(int winningPlayer) {
  display.clearDisplay();
  display.setTextSize(1);
  display.setTextColor(SSD1306_WHITE);
  display.setCursor(0, 10);
  display.print("PLAYER ");
  display.print(winningPlayer);
  display.println(" WINS!");
  display.display();
  delay(2000);
}

void updateDisplay() {
  display.clearDisplay();
  display.setTextSize(1);
  display.setTextColor(SSD1306_WHITE);
  display.setCursor(0, 10);
  display.print("Game Mode: ");
  display.println(selectedGame == GAME_40_POINTS ? "40 Points" : "22 Points");
  display.print("Number of Players: ");
  display.println(numberOfPlayers);
  display.display();
}

void updateLEDsBasedOnScore(int score) {
  uint32_t color;
  if (score <= 10) {
    color = strip.Color(255, 0, 0);
  } else if (score <= 20) {
    color = strip.Color(0, 255, 0);
  } else {
    color = strip.Color(0, 0, 255);
  }

  for (int i = 0; i < strip.numPixels(); i++) {
    strip.setPixelColor(i, color);
  }
  strip.show();
}

void updateGameSelectionScreen() {
  display.clearDisplay();

  // Display the bitmap image for the selected game
  if (selectedGame == GAME_22_POINTS) {
    display.drawBitmap(0, 0, epd_bitmap_gameMode22, 128, 64, SSD1306_WHITE);
  } else {
    display.drawBitmap(0, 0, epd_bitmap_gameMode40, 128, 64, SSD1306_WHITE);
  }

  // Display text on top of the bitmap
  display.setTextSize(1);
  display.setTextColor(SSD1306_WHITE);
  display.setCursor(0, 10);
  display.println();
  display.display();
}

void updatePlayerSelectionScreen() {
  display.clearDisplay();

  // Select and display the appropriate bitmap based on the number of players
  switch (numberOfPlayers) {
    case 1:
      display.drawBitmap(0, 0, player_1_bitmap, 128, 64, SSD1306_WHITE);
      break;
    case 2:
      display.drawBitmap(0, 0, player_2_bitmap, 128, 64, SSD1306_WHITE);
      break;
    case 3:
      display.drawBitmap(0, 0, player_3_bitmap, 128, 64, SSD1306_WHITE);
      break;
    case 4:
      display.drawBitmap(0, 0, player_4_bitmap, 128, 64, SSD1306_WHITE);
      break;
    case 5:
      display.drawBitmap(0, 0, player_5_bitmap, 128, 64, SSD1306_WHITE);
      break;
    case 6:
      display.drawBitmap(0, 0, player_6_bitmap, 128, 64, SSD1306_WHITE);
      break;
    case 7:
      display.drawBitmap(0, 0, player_7_bitmap, 128, 64, SSD1306_WHITE);
      break;
    case 8:
      display.drawBitmap(0, 0, player_8_bitmap, 128, 64, SSD1306_WHITE);
      break;
    default:
      break;
  }

  display.display();
}
